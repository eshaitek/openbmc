## meta-evb/meta-evb-raspberrypi/meta-rpi4/conf/layer.conf
```bitbake
# We have a conf and classes directory, add to BBPATH
BBPATH .= ":${LAYERDIR}"

# We have recipes-* directories, add to BBFILES
BBFILES += "${LAYERDIR}/recipes-*/*/*.bb \
            ${LAYERDIR}/recipes-*/*/*.bbappend"

BBFILE_COLLECTIONS += "rpi4-layer"
BBFILE_PATTERN_rpi4-layer := "^${LAYERDIR}/"
LAYERSERIES_COMPAT_rpi4-layer = "warrior zeus dunfell gatesgarth"
```
